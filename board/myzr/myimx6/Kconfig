## board/myzr/myimx6/Kconfig
```kconfig
if (TARGET_MYIMX6EK200 || TARGET_MYIMX6EK314 || TARGET_MYIMX6EK336)

config SYS_BOARD
	default "myimx6"

config SYS_VENDOR
	default "myzr"

config SYS_SOC
	default "mx6"

config SYS_CONFIG_NAME
	default "myimx6a9"
	
endif

if (TARGET_MYIMX6EK140 || TARGET_MYIMX6EK140P)

config SYS_BOARD
	default "myimx6"

config SYS_VENDOR
	default "myzr"

config SYS_SOC
	default "mx6"

config SYS_CONFIG_NAME
	default "myimx6a7"
	
endif
```

## board/myzr/myimx6ek200/Kconfig
```kconfig
if TARGET_MYIMX6EK200

config SYS_BOARD
	default "myimx6ek200"

config SYS_VENDOR
	default "myzr"

config SYS_SOC
	default "mx6"

config SYS_CONFIG_NAME
	default "myimx6ek200"

endif
```

## board/tdc/jycz2/Kconfig
```kconfig
if TARGET_JYCZ2

config SYS_BOARD
	default "jycz2"

config SYS_VENDOR
	default "tdc"

config SYS_CONFIG_NAME
	default "jycz2"

config SYS_TEXT_BASE
	default 0x17800000

config SYS_MMC_BOOT_DEV
	int "Boot from which MMC dev-num"
	default 1

config SYS_MMC_BOOT_PART
	int "Boot from which MMC part-num"
	default 2

endif
```

## board/vaxpl/Kconfig
```kconfig
config VAXPL_QX1
	bool "Support Vaxpl QX1 board"
	default n

if VAXPL_QX1
source "board/vaxpl/qx1/Kconfig"
endif
```

## board/vaxpl/defconfigs/qx1_defconfig
```kconfig
CONFIG_ARM=y
CONFIG_TARGET_MESON_G12B=y
CONFIG_VAXPL_QX1=y
CONFIG_DM=y
CONFIG_DM_GPIO=y
CONFIG_AML_GPIO=y
```

## configs/myimx6ek140-6g-512m-emmc_defconfig
```kconfig
CONFIG_ARM=y
CONFIG_ARCH_MX6=y
CONFIG_TARGET_MYIMX6EK140=y
CONFIG_SYS_EXTRA_OPTIONS="IMX_CONFIG=board/myzr/myimx6/myimx6a7-6g-ddr3.cfg,MYIMX6G,DDR_MB=512"
CONFIG_CMD_GPIO=y
```

## configs/myimx6ek140-6g_defconfig
```kconfig
CONFIG_SYS_EXTRA_OPTIONS="IMX_CONFIG=board/myzr/myimx6/myimx6cb140.cfg,MX6UL,DRAM_SIZE=256"
CONFIG_ARM=y
CONFIG_TARGET_MYIMX6EK140=y
CONFIG_SYS_MALLOC_F=y
CONFIG_SYS_MALLOC_F_LEN=0x400
CONFIG_DM=y
CONFIG_DM_THERMAL=y
```

## configs/myimx6ek140-6y-512m-emmc_defconfig
```kconfig
CONFIG_ARM=y
CONFIG_ARCH_MX6=y
CONFIG_TARGET_MYIMX6EK140=y
CONFIG_SYS_EXTRA_OPTIONS="IMX_CONFIG=board/myzr/myimx6/myimx6a7-6y-ddr3.cfg,MX6ULL,MYIMX6Y,DDR_MB=512"
CONFIG_CMD_GPIO=y
```

## configs/myimx6ek140p-6g-128m-emmc_defconfig
```kconfig
CONFIG_ARM=y
CONFIG_ARCH_MX6=y
CONFIG_TARGET_MYIMX6EK140P=y
CONFIG_SYS_EXTRA_OPTIONS="IMX_CONFIG=board/myzr/myimx6/myimx6a7-6g-ddr3.cfg,MYIMX6G,DDR_MB=128"
CONFIG_CMD_GPIO=y
```

## configs/myimx6ek200-6q-cm3_defconfig
```kconfig
CONFIG_ARM=y
CONFIG_ARCH_MX6=y
CONFIG_TARGET_MYIMX6EK200=y
CONFIG_SYS_EXTRA_OPTIONS="IMX_CONFIG=board/myzr/myimx6ek200/myimx6qdls.cfg,MX6Q,SYS_BOOT_SPINOR,PR_CVR_MIL_V3"
CONFIG_CMD_GPIO=y
```

## configs/myimx6ek200_6q_defconfig
```kconfig
CONFIG_ARM=y
CONFIG_TARGET_MYIMX6EK200=y
CONFIG_SYS_EXTRA_OPTIONS="IMX_CONFIG=board/myzr/myimx6ek200/myimx6qdls.cfg,MX6Q,SYS_BOOT_SPINOR"
CONFIG_CMD_GPIO=y
CONFIG_DM=y
CONFIG_DM_THERMAL=y
```

## configs/myimx6ek314-6q-1g_defconfig
```kconfig
CONFIG_ARM=y
CONFIG_ARCH_MX6=y
CONFIG_TARGET_MYIMX6EK314=y
CONFIG_SYS_EXTRA_OPTIONS="IMX_CONFIG=board/myzr/myimx6/myimx6a9-6q-ddr3.cfg,MYIMX6Q,DDR_MB=1024"
CONFIG_CMD_GPIO=y
```

## configs/myimx6ek314-6qp-1g_defconfig
```kconfig
CONFIG_ARM=y
CONFIG_ARCH_MX6=y
CONFIG_TARGET_MYIMX6EK314=y
CONFIG_SYS_EXTRA_OPTIONS="IMX_CONFIG=board/myzr/myimx6/myimx6a9-6qp-ddr3.cfg,MYIMX6QP,DDR_MB=1024"
CONFIG_CMD_GPIO=y
```

## configs/myimx6ek314-6s-512m_defconfig
```kconfig
CONFIG_ARM=y
CONFIG_ARCH_MX6=y
CONFIG_TARGET_MYIMX6EK314=y
CONFIG_SYS_EXTRA_OPTIONS="IMX_CONFIG=board/myzr/myimx6/myimx6a9-6s-ddr3.cfg,MYIMX6S,DDR_MB=512,SYS_NOSMP=\"nosmp\""
CONFIG_CMD_GPIO=y
```

## configs/myimx6ek314-v10-6q-2g_defconfig
```kconfig
CONFIG_SYS_EXTRA_OPTIONS="IMX_CONFIG=board/myzr/myimx6/myimx6qdls.cfg,MX6Q,DDR_MB=2048,CB314_IS_V10"
CONFIG_ARM=y
CONFIG_TARGET_MYIMX6EK314=y
CONFIG_DM=y
CONFIG_DM_THERMAL=y
```

## configs/myimx6ek336-6qp-dbg_defconfig
```kconfig
CONFIG_SYS_EXTRA_OPTIONS="IMX_CONFIG=board/myzr/myimx6/myimx6cb336.cfg,MX6QP,DBG_DDR,DDR_MB=1024"
CONFIG_ARM=y
CONFIG_TARGET_MYIMX6EK336=y
CONFIG_DM=y
CONFIG_DM_THERMAL=y
```

## configs/myimx6lef-6q-dbg_defconfig
```kconfig
CONFIG_SYS_EXTRA_OPTIONS="IMX_CONFIG=board/myzr/myimx6/myimx6lef.cfg,MX6Q,DBG_DDR,DDR_MB=1024"
CONFIG_ARM=y
CONFIG_TARGET_MYIMX6LEF=y
CONFIG_DM=y
CONFIG_DM_THERMAL=y
```

## configs/myimx6qjh-6q_defconfig
```kconfig
CONFIG_SYS_EXTRA_OPTIONS="IMX_CONFIG=board/myzr/myimx6/myimx6cb336.cfg,MX6Q,DDR_MB=1024"
CONFIG_ARM=y
CONFIG_TARGET_MYIMX6QJH=y
CONFIG_DM=y
CONFIG_DM_THERMAL=y
```
